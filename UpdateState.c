
#include <stdint.h>
#include "../inc/tm4c123gh6pm.h"
#include "ST7735.h"
#include "ADC.h"
#include "Shoot.h"

#define Tank_Width 26
#define Tank_Height 26
#define blackHeight 25
#define bullet_Width 8
#define bullet_Height 8
#define Num_Bullets 5

void DisableInterrupts(void); // Disable interrupts
void EnableInterrupts(void);  // Enable interrupts

extern int shootFlag;
extern int shootFlag2;
const unsigned short whiteBullet[] = {
 0xFFFF, 0xFFFF, 0xFFFF, 0xFFFF, 0xFFFF, 0xFFFF, 0xFFFF, 0xFFFF, 0xFFFF, 0xFFFF, 0xFFFF, 0xFFFF, 0xFFFF, 0xFFFF, 0xFFFF, 0xFFFF,
 0xFFFF, 0xFFFF, 0xFFFF, 0xFFFF, 0xFFFF, 0xFFFF, 0xFFFF, 0xFFFF, 0xFFFF, 0xFFFF, 0xFFFF, 0xFFFF, 0xFFFF, 0xFFFF, 0xFFFF, 0xFFFF,
 0xFFFF, 0xFFFF, 0xFFFF, 0xFFFF, 0xFFFF, 0xFFFF, 0xFFFF, 0xFFFF, 0xFFFF, 0xFFFF, 0xFFFF, 0xFFFF, 0xFFFF, 0xFFFF, 0xFFFF, 0xFFFF,
 0xFFFF, 0xFFFF, 0xFFFF, 0xFFFF, 0xFFFF, 0xFFFF, 0xFFFF, 0xFFFF, 0xFFFF, 0xFFFF, 0xFFFF, 0xFFFF, 0xFFFF, 0xFFFF, 0xFFFF, 0xFFFF,
};
const unsigned short bullet[] = {
 0xFFFF, 0xFFFF, 0xFFFF, 0xFFFF, 0xFFFF, 0xFFFF, 0xFFFF, 0xFFFF, 0xFFFF, 0xFFFF, 0xFFFF, 0xFFFF, 0xFFFF, 0xFFFF, 0xFFFF, 0xFFFF,
 0xFFFF, 0xFFFF, 0x6412, 0x2AAF, 0x2AEF, 0xBE18, 0xFFFF, 0xFFFF, 0xFFFF, 0xFFFF, 0x345B, 0x4DBF, 0x76BF, 0x53D2, 0xFFFF, 0xFFFF,
 0xFFFF, 0xFFFF, 0x3CFB, 0x5E3F, 0x9F1F, 0x6412, 0xFFFF, 0xFFFF, 0xFFFF, 0xFFFF, 0x4C76, 0x7DFC, 0x861C, 0x7C93, 0xFFFF, 0xFFFF,
 0xFFFF, 0xFFFF, 0xFFFF, 0xFFFF, 0xFFFF, 0xFFFF, 0xFFFF, 0xFFFF, 0xFFFF, 0xFFFF, 0xFFFF, 0xFFFF, 0xFFFF, 0xFFFF, 0xFFFF, 0xFFFF,


};


const unsigned short tankUp[] = {
 0xFFFF, 0xFFFF, 0xFFFF, 0xFFFF, 0xFFFF, 0xFFFF, 0xFFFF, 0xFFFF, 0xFFFF, 0xFFFF, 0xFFFF, 0xFFFF, 0xFFFF, 0xFFFF, 0xFFFF, 0xFFFF,
 0xFFFF, 0xFFFF, 0xFFFF, 0xFFFF, 0xFFFF, 0xFFFF, 0xFFFF, 0xFFFF, 0xFFFF, 0xFFFF, 0xFFFF, 0xFFFF, 0xFFFF, 0xFFFF, 0xFFFF, 0xFFFF,
 0xFFFF, 0xFFFF, 0xFFFF, 0xFFFF, 0xFFFF, 0xFFFF, 0xFFFF, 0xFFFF, 0xFFFF, 0xFFFF, 0xFFFF, 0xFFFF, 0xFFFF, 0xFFFF, 0xFFFF, 0xFFFF,
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 0xFFFF, 0xFFFF, 0xFFFF, 0xFFFF,

};







const unsigned short tankRight[] = {
 0xFFFF, 0xFFFF, 0xFFFF, 0xFFFF, 0xFFFF, 0xFFFF, 0xFFFF, 0xFFFF, 0xFFFF, 0xFFFF, 0xFFFF, 0xFFFF, 0xFFFF, 0xFFFF, 0xFFFF, 0xFFFF,
 0xFFFF, 0xFFFF, 0xFFFF, 0xFFFF, 0xFFFF, 0xFFFF, 0xFFFF, 0xFFFF, 0xFFFF, 0xFFFF, 0xFFFF, 0xFFFF, 0xFFFF, 0xFFFF, 0xFFFF, 0xFFFF,
 0xFFFF, 0xFFFF, 0xFFFF, 0xFFFF, 0xFFFF, 0xFFFF, 0xFFFF, 0xFFFF, 0xFFFF, 0xFFFF, 0xFFFF, 0xFFFF, 0xFFFF, 0xFFFF, 0xFFFF, 0xFFFF,
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 0xFFFF, 0xFFFF, 0xFFFF, 0xFFFF,

};

const unsigned short tankLeft[] = {
 0xFFFF, 0xFFFF, 0xFFFF, 0xFFFF, 0xFFFF, 0xFFFF, 0xFFFF, 0xFFFF, 0xFFFF, 0xFFFF, 0xFFFF, 0xFFFF, 0xFFFF, 0xFFFF, 0xFFFF, 0xFFFF,
 0xFFFF, 0xFFFF, 0xFFFF, 0xFFFF, 0xFFFF, 0xFFFF, 0xFFFF, 0xFFFF, 0xFFFF, 0xFFFF, 0xFFFF, 0xFFFF, 0xFFFF, 0xFFFF, 0xFFFF, 0xFFFF,
 0xFFFF, 0xFFFF, 0xFFFF, 0xFFFF, 0xFFFF, 0xFFFF, 0xFFFF, 0xFFFF, 0xFFFF, 0xFFFF, 0xFFFF, 0xFFFF, 0xFFFF, 0xFFFF, 0xFFFF, 0xFFFF,
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 0xFFFF, 0xFFFF, 0xFFFF, 0xFFFF,

};

const unsigned short tankDown[] = {
 0xFFFF, 0xFFFF, 0xFFFF, 0xFFFF, 0xFFFF, 0xFFFF, 0xFFFF, 0xFFFF, 0xFFFF, 0xFFFF, 0xFFFF, 0xFFFF, 0xFFFF, 0xFFFF, 0xFFFF, 0xFFFF,
 0xFFFF, 0xFFFF, 0xFFFF, 0xFFFF, 0xFFFF, 0xFFFF, 0xFFFF, 0xFFFF, 0xFFFF, 0xFFFF, 0xFFFF, 0xFFFF, 0xFFFF, 0xFFFF, 0xFFFF, 0xFFFF,
 0xFFFF, 0xFFFF, 0xFFFF, 0xFFFF, 0xFFFF, 0xFFFF, 0xFFFF, 0xFFFF, 0xFFFF, 0xFFFF, 0xFFFF, 0xFFFF, 0xFFFF, 0xFFFF, 0xFFFF, 0xFFFF,
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 0xFFFF, 0xFFFF, 0xFFFF, 0xFFFF,

};



typedef enum direction {up = 0, down = 1, left = 2, right = 3} direction_t;
typedef enum bulletLife {dead = 0, alive = 1} bulletLife_t;




const unsigned short *tanks [4] = {tankUp, tankDown, tankLeft, tankRight};
typedef struct bullet{
	
	int16_t xCoordinate;
	int16_t yCoordinate;
	bulletLife_t bulletLife;
	direction_t direction;
	
	
} bullet_t;



typedef struct Player{
	int16_t xCoordinate;
	int16_t yCoordinate;
	int8_t health;
	direction_t direction;
	bullet_t bullet[Num_Bullets];
	
} player_t;


player_t player1 = {0, 160, 100, up};
player_t player2 = {128-Tank_Width, blackHeight + Tank_Height, 100, down};




void Init_State(void) {
	
	// set up for the screen gameplay
	// puts tanks in the corners
	
	ST7735_FillScreen(0xFFFF);
	
	ST7735_FillRect(0, 0, 128, blackHeight, 0x0000);
	
	ST7735_SetCursor(1,0);
	
	
	ST7735_OutString("Player 1");
	
	ST7735_SetCursor(12,0);
	
	
	ST7735_OutString("Player 2");
	
	ST7735_DrawFastVLine(64, 0, blackHeight, 0x07FF);
	
	ST7735_FillRect(0, 10, 60, 10, 0x57E0);
	
	ST7735_FillRect(68, 10, 60, 10, 0x57E0);
	
	for (int i = 0; i < Num_Bullets; i++) {
		player1.bullet[i].xCoordinate = 0;
		player1.bullet[i].yCoordinate = 0;
		player1.bullet[i].bulletLife = dead;
		player1.bullet[i].direction = up;
		
		
		player2.bullet[i].xCoordinate = 0;
		player2.bullet[i].yCoordinate = 0;
		player2.bullet[i].bulletLife = dead;
		player2.bullet[i].direction = up;
		
	}
	
}


void UpdatePlayer (player_t* player, uint32_t ADCval[2]) {
	
	// Updates the players movement based on the position of the joystick
	
	
	// Here we check if a player is at the edges 
	
		if (ADCval[0] > 3600) {
		player->direction = up;
		if (player->yCoordinate > (blackHeight + Tank_Height)) {
			
		player->yCoordinate -= 1;
			
		}
		
		
	}
	
	if (ADCval[1] > 3600) {
		player->direction = right;
		if (player->xCoordinate < (128-Tank_Width)) {
			player->xCoordinate += 1;
		
		}
		
	}
	
	if (ADCval[0] < 1600) {
		player->direction = down;
		if (player->yCoordinate < 160) {
		player->yCoordinate += 1;
		}
	}
		
	if (ADCval[1] < 1600) {
		player->direction = left;
		if (player->xCoordinate > 0) {
		player->xCoordinate -= 1;
		}
		
	}
	
	
	
	
	
}

void UpdateBullet(player_t *player, int *Flag) {
	// Updates the bullets of each player
	// Turns bullets alive if the button is pressed and increments all alive bullets for the player passed in
	// DOES NOT CHECK if the bullet should dissapear
	
	
	//Loops through each bullet and updates it
	for (int i = 0; i<Num_Bullets; i++) {
		
		
	// starts the bullet
	if (*Flag == 1 && player->bullet[i].bulletLife == dead){
		*Flag = 0;
		player->bullet[i].bulletLife = alive ;
		player->bullet[i].direction = player-> direction ;
		
		if (player->bullet[i].direction == up) {
			player->bullet[i].xCoordinate = player->xCoordinate + 9 ;
			player->bullet[i].yCoordinate = player->yCoordinate - 24 ;
		}
		if (player->bullet[i].direction == down) {
			player->bullet[i].xCoordinate = player->xCoordinate +9 ;
			player->bullet[i].yCoordinate = player->yCoordinate +4 ;
		}
		if (player->bullet[i].direction == left) {
			player->bullet[i].xCoordinate = player->xCoordinate-4 ;
			player->bullet[i].yCoordinate = player->yCoordinate - 9 ;
		}
		if (player->bullet[i].direction == right) {
			player->bullet[i].xCoordinate = player->xCoordinate + Tank_Height ;
			player->bullet[i].yCoordinate = player->yCoordinate - 9 ;
		}
		
		
		
	}
	// increments the bullet
	if ( player->bullet[i].bulletLife == alive ) {
		if (player->bullet[i].direction == up) {
			player->bullet[i].yCoordinate -= 2;
		}
		
		if (player->bullet[i].direction == down) {
			player->bullet[i].yCoordinate += 2;
		}
				
		if (player->bullet[i].direction == left) {
			player->bullet[i].xCoordinate -= 2;
		}
				
		if (player->bullet[i].direction == right) {
			player->bullet[i].xCoordinate += 2;
		}
		
	}
	
	if (player-> bullet[i].bulletLife == dead) {
		
	}
	
}
	
}



void CheckBullet(player_t *player) {

	// checks all bullets for the player passed in 
	// makes them dissapear if they should be dead
	// skips if they are already dead
	
	
	// here we check if a bullet has reached an edge
	
	for (int i = 0; i<Num_Bullets; i++) {
	
	if (player->bullet[i].bulletLife == alive){
		if (player->bullet[i].yCoordinate <= blackHeight + bullet_Height) {
			player->bullet[i].bulletLife = dead ;
			ST7735_DrawBitmap(player->bullet[i].xCoordinate, player->bullet[i].yCoordinate, whiteBullet, bullet_Width, bullet_Height);
		}
		if (player->bullet[i].yCoordinate > 160) {
			player->bullet[i].bulletLife = dead ;
			ST7735_DrawBitmap(player->bullet[i].xCoordinate, player->bullet[i].yCoordinate, whiteBullet, bullet_Width, bullet_Height);
		}
		if (player->bullet[i].xCoordinate > 128-bullet_Width ){
			player->bullet[i].bulletLife = dead ;
			ST7735_DrawBitmap(player->bullet[i].xCoordinate, player->bullet[i].yCoordinate, whiteBullet, bullet_Width, bullet_Height);
		}
		if (player->bullet[i].xCoordinate < 0) {
			player->bullet[i].bulletLife = dead ;
			ST7735_DrawBitmap(player->bullet[i].xCoordinate, player->bullet[i].yCoordinate, whiteBullet, bullet_Width, bullet_Height);
		}
		
		
		
		
	}
	
	
	
	
	
	
	
	// here we check if a bullet has hit another object (rebound)?
	
	
	
}
	
	
}


void CheckPlayerCollision(void){
	
	for (int i =0; i<Num_Bullets; i++){
	
	if (player2.bullet[i].bulletLife == alive) {
		
				int xDifference = player1.xCoordinate - player2.bullet[i].xCoordinate;
				
				int yDifference = player1.yCoordinate - player2.bullet[i].yCoordinate;
				
				if (xDifference > -(Tank_Width - 5) && xDifference < (bullet_Width-5) && 
					yDifference > -(bullet_Height-5) && yDifference < (Tank_Height-5)) {
					
					 player1.health -= 10;
					 player2.bullet[i].bulletLife = dead;
					 ST7735_DrawBitmap(player2.bullet[i].xCoordinate, player2.bullet[i].yCoordinate, whiteBullet, bullet_Width, bullet_Height);
						
					
					
				} 
}
	
	if (player1.bullet[i].bulletLife == alive) {
		
				int xDifference = player2.xCoordinate - player1.bullet[i].xCoordinate;
				int yDifference = player2.yCoordinate - player1.bullet[i].yCoordinate;
		
		
				if (xDifference > -(Tank_Width - 5) && xDifference < (bullet_Width-5) && 
					yDifference > -(bullet_Height-5) && yDifference < (Tank_Height-5)) {
					
					 player2.health -= 10;
					 player1.bullet[i].bulletLife = dead;
					 ST7735_DrawBitmap(player1.bullet[i].xCoordinate, player1.bullet[i].yCoordinate, whiteBullet, bullet_Width, bullet_Height);
					
				} 

				
			
}
	
}
	
	
	
	
	
	
}




void UpdateState(void) {
	uint32_t ADCval[2];
	
	
	ADC_In67 (ADCval);
	UpdatePlayer(&player1, ADCval) ;
	ADC_In89 (ADCval);
	UpdatePlayer(&player2, ADCval) ;
	
	
	UpdateBullet(&player1, &shootFlag);
	UpdateBullet(&player2, &shootFlag2);
	CheckBullet (&player1);
	CheckBullet (&player2);
	CheckPlayerCollision();
	

	
	
}




void Render(void) {
	
	

	
	ST7735_DrawBitmap(player1.xCoordinate, player1.yCoordinate, tanks[player1.direction], Tank_Width, Tank_Height);
	
	ST7735_DrawBitmap(player2.xCoordinate, player2.yCoordinate, tanks[player2.direction], Tank_Width, Tank_Height);
	
	for (int i = 0; i<Num_Bullets; i++) {
	
	if (player1.bullet[i].bulletLife == alive) {
		
		ST7735_DrawBitmap(player1.bullet[i].xCoordinate, player1.bullet[i].yCoordinate, bullet, bullet_Width, bullet_Height);
		
	}
	
	
	if (player2.bullet[i].bulletLife == alive) {
		
		ST7735_DrawBitmap(player2.bullet[i].xCoordinate, player2.bullet[i].yCoordinate, bullet, bullet_Width, bullet_Height);
		
	}
		
	}
	
	ST7735_SetCursor(0,1);
	LCD_OutDec (player1.health);
	
	
	
	ST7735_SetCursor(5,1);
  LCD_OutDec(player2.health);
	
	
	
	
	

	
	
	
	
}


void Update (void) {
	DisableInterrupts();
	UpdateState();
	Render();
	shootFlag = 0 ;
	shootFlag2 = 0;
	EnableInterrupts();
}




